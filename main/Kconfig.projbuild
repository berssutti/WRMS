## main/Kconfig.projbuild
```kconfig
################ WIFI #################

menu "Configuração do Wifi"

    config ESP_WIFI_SSID
        string "WiFi SSID"
        default "ssid"
        help
            Nome da rede Wifi.

    config ESP_WIFI_PASSWORD
        string "Senha do Wifi"
        default "minha_senha"
        help
            Senha do WiFi (WPA or WPA2).

    config ESP_MAXIMUM_RETRY
        int "Número máximo de tentativas de conexão"
        default 5
        help
            Configure o valor máximo de tentativas de conexão.
endmenu

menu "MQTT"
    config ESP_MQTT_TOKEN
        string "MQTT TOKEN"
        default "ndAHaTa7wTJcWd4VoCWn"
        help
            Token para conexão MQTT.

    config ESP_MQTT_HOST_IP
        string "IP do Computador Host do Thingsboard"
        default "192.168.0.12"
        help
            IP do computador host do Thingsboard.
endmenu



################# GPS ###################
```
